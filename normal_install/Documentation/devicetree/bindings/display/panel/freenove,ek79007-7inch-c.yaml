## normal_install/Documentation/devicetree/bindings/display/panel/freenove,ek79007-7inch-c.yaml
```yaml
# SPDX-License-Identifier: (GPL-2.0-only OR BSD-2-Clause)
%YAML 1.2
---
$id: http://devicetree.org/schemas/display/panel/freenove,ek79007-7inch-c.yaml#
$schema: http://devicetree.org/meta-schemas/core.yaml#

title: Freenove 7-inch DSI panel with EK79007 controller

maintainers:
  - Zhentao-Lin <173039613@qq.com>

description: |
  The Freenove 7inch-C DSI panel uses an EK79007 glass with a resolution of
  1024x600, connected via a 2-lane MIPI DSI video-mode link.  Power/reset and
  backlight are controlled by an on-panel I2C MCU at address 0x45, which is
  handled by a separate driver (freenove,panel-mcu).

allOf:
  - $ref: panel-common.yaml#

properties:
  compatible:
    const: freenove,ek79007-7inch-c

  reg:
    description: DSI virtual channel number
    maxItems: 1

  reset-gpios:
    description: Reset line of the panel (active-high)
    maxItems: 1

  iovcc-gpios:
    description: IOVCC regulator line (active-high)
    maxItems: 1

  avdd-gpios:
    description: AVDD regulator line (active-high)
    maxItems: 1

  backlight:
    $ref: /schemas/types.yaml#/definitions/phandle
    description: Phandle to the backlight device registered by the panel MCU

  rotation:
    $ref: /schemas/types.yaml#/definitions/uint32
    description: Panel rotation in degrees (0, 90, 180, 270)
    enum: [0, 90, 180, 270]

  port:
    $ref: /schemas/graph.yaml#/properties/port
    description: |
      Panel input port.  Must contain one endpoint connected to the DSI host
      output endpoint.

required:
  - compatible
  - reg
  - reset-gpios
  - iovcc-gpios
  - avdd-gpios
  - backlight
  - port

additionalProperties: false

examples:
  - |
    #include <dt-bindings/gpio/gpio.h>

    dsi_panel: dsi_panel@0 {
        compatible = "freenove,ek79007-7inch-c";
        reg = <0>;
        reset-gpios = <&panel_mcu 1 GPIO_ACTIVE_HIGH>;
        iovcc-gpios = <&panel_mcu 4 GPIO_ACTIVE_HIGH>;
        avdd-gpios = <&panel_mcu 0 GPIO_ACTIVE_HIGH>;
        backlight = <&panel_mcu>;

        port {
            panel_in: endpoint {
                remote-endpoint = <&dsi_out>;
            };
        };
    };
```

## normal_install/Documentation/devicetree/bindings/regulator/freenove,panel-mcu.yaml
```yaml
# SPDX-License-Identifier: (GPL-2.0-only OR BSD-2-Clause)
%YAML 1.2
---
$id: http://devicetree.org/schemas/regulator/freenove,panel-mcu.yaml#
$schema: http://devicetree.org/meta-schemas/core.yaml#

title: Freenove DSI panel on-board MCU (I2C)

maintainers:
  - Zhentao-Lin <173039613@qq.com>

description: |
  The Freenove "7inch C" MIPI-DSI panel carries a small MCU on the panel PCB,
  connected to the DSI connector's I2C bus at address 0x45. It drives every
  power rail, the reset line and the backlight of the EK79007 glass; none of
  those reach the SoC directly.

  Its outputs are a single 16-bit mask held in registers 0x94 (bits 15..8) and
  0x95 (bits 7..0), which cannot be read back, plus a backlight duty register
  0x96. The driver reshapes that protocol into standard kernel interfaces: a
  16-line GPIO controller (bit N is line N), a backlight device, and a
  regulator for bit 4 (IOVCC) that also feeds the panel's GT911 touch so the
  touch probe is deferred until the rail is up.

properties:
  compatible:
    const: freenove,panel-mcu

  reg:
    maxItems: 1

  gpio-controller: true

  "#gpio-cells":
    const: 2
    description: |
      The first cell is the mask bit number (0..15); the second cell holds the
      usual GPIO flags.

  enable-gpios:
    maxItems: 1
    description: |
      Optional backlight enable gate. Points back at this controller's own
      BL_EN bit (bit 2), so it is only usable once the GPIO chip is registered.

required:
  - compatible
  - reg
  - gpio-controller
  - "#gpio-cells"

additionalProperties: false

examples:
  - |
    #include <dt-bindings/gpio/gpio.h>

    i2c {
        #address-cells = <1>;
        #size-cells = <0>;

        panel_mcu: panel-mcu@45 {
            compatible = "freenove,panel-mcu";
            reg = <0x45>;

            gpio-controller;
            #gpio-cells = <2>;

            enable-gpios = <&panel_mcu 2 GPIO_ACTIVE_HIGH>;
        };
    };
```
